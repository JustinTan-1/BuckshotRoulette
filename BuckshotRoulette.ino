
#include <LiquidCrystal.h>
#include <PCM.h>

int ammo = 8;
const int triggerPin = 2;
const int menuButtonPin = 3;

int buttonState = 0;
int liveCount = 0;
int blankCount = 0;

const unsigned char sample[] PROGMEM = {
  129, 126, 127, 128, 127, 127, 127, 128, 127, 127, 128, 127,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 123, 
};

const unsigned char gunshot[] PROGMEM {
130, 129, 128, 128, 129, 128, 127, 129, 129, 127, 127, 126,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 129, 
};

const unsigned char blank[] PROGMEM {
129, 128, 127, 128, 128, 127, 127, 128, 127, 128, 127, 127,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 127, 
};

const unsigned char rack[] PROGMEM {
  126, 128, 128, 127, 128, 127, 128, 128, 127, 128, 128, 127,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 128, 
};

const unsigned char button[] PROGMEM {
126, 129, 127, 127, 128, 128, 127, 128, 128, 127, 128, 127,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 128, };


static int shellOrder[] = {-1,-1,-1,-1,-1,-1,-1,-1};

unsigned long lastTimeUpdated = millis();
unsigned long updateDelay = 500;

LiquidCrystal lcd(7,8,9,10,6,12);

void setup() {
  // initialize serial communication:
  Serial.begin(9600);
  pinMode(triggerPin, INPUT);
  pinMode(menuButtonPin, INPUT);
  lcd.begin(16,2);
  reloadShells();
}

void loop() {
  int totalShells = liveCount + blankCount;
  for (int i = 0; i < totalShells; i++) {
    while (digitalRead(triggerPin) == LOW && digitalRead(menuButtonPin) == LOW) {
    }
    if (digitalRead(menuButtonPin) == HIGH) {
      int choice = menuLoop();
      switch (choice) {
        case 0:
          magnifyingGlass(i);
          break;
        case 1:
          lcd.clear();
          startPlayback(rack, sizeof(rack));
          delay(400);
          startPlayback(blank, sizeof(blank));
          lcd.print("Shell Ejected");
          i++;
          break;
        case 2:
          inverter(i);
          break;
        case 3:
          phone(i, totalShells - 1);
          break;
        case 4:
          lcd.clear();
          break;
        }
        i--;
        delay(2000);
        lcd.clear();
    } else {
      if (shellOrder[i] == 1) {
      lcd.clear();
      lcd.print("BANG!");
      startPlayback(gunshot, sizeof(gunshot));
    } else if (shellOrder[i] == 0) {
      lcd.clear();
      lcd.print("EMPTY");
      startPlayback(blank, sizeof(blank));
    }
    delay(1000);
    lcd.clear();
    }
  }
  delay(100);
  reloadShells();
}

int menuLoop() {
  startPlayback(button, sizeof(button));
  boolean stop = false;
  String choices[] = {"Magnifying Glass", "Beer", "Inverter", "Burner Phone", "Exit"};
  int counter = 0;
  lcd.clear();
  lcd.print("---Power Menu---");
  lcd.setCursor(0,1);
  lcd.print(choices[counter]);
  delay(500);
  while (digitalRead(triggerPin) == LOW) {
    while (digitalRead(menuButtonPin) == LOW) {
      if (digitalRead(triggerPin) == HIGH) {
        stop = true;
        break;
      }
    }
    startPlayback(button, sizeof(button));
    if (stop == true) {
      return counter;
    }
    if (counter == 4) {
      counter = -1;
    }
    counter++;
    lcd.clear();
    lcd.print("---Power Menu---");
    lcd.setCursor(0,1);
    lcd.print(choices[counter]);
    delay(500);
  }
}

void magnifyingGlass(int index) {
  lcd.clear();
  lcd.print("Next Shell:");
  lcd.setCursor(0,1);
  if (shellOrder[index] == 0) {
    lcd.print("EMPTY");
  } else {
    lcd.print("LIVE");
  }
}

void inverter(int index) {
  lcd.clear();
  lcd.print("Shell Inverted");
  if (shellOrder[index] == 0) {
    shellOrder[index] = 1;
  } else if (shellOrder[index] == 1){
    shellOrder[index] = 0;
  }
}

void phone(int current, int max_index) {
  if (current == max_index) {
    lcd.clear();
    lcd.print("Unfortunate...");
  } else {
    randomSeed(analogRead(A0));
    int top_difference = max_index - current;
    Serial.println(top_difference);
    int randomDifference = random(1, top_difference + 1);
    if (shellOrder[current + randomDifference] == 1) {
      lcd.clear();
      lcd.print("Shell " + String(randomDifference) + " away");
      lcd.setCursor(0,1);
      lcd.print("is LIVE");
    } else if (shellOrder[current + randomDifference] == 0) {
      lcd.clear();
      lcd.print("Shell " + String(randomDifference) + " away");
      lcd.setCursor(0,1);
      lcd.print("is BLANK");
    }
  }
}

void reloadShells(){
  liveCount = 0;
  blankCount = 0;
   for (int i = 0; i < 8; i++) {
      shellOrder[i] = -1;
   }
   lcd.clear();
   lcd.setCursor(0,0);
   lcd.print("Inserting");
   lcd.setCursor(0,1);
   lcd.print("Shells...");
   randomSeed(analogRead(A0));
   int numberOfShells = random(3,9);
   randomSeed(analogRead(A0));
   for (int i = 0; i < numberOfShells; i++) {
    int randomNumber = random(2);
    shellOrder[i] = randomNumber;
    startPlayback(sample, sizeof(sample));
    delay(400);
   }
   for (int i = 0; i < 8; i++) {
    Serial.print(shellOrder[i]);
      if (shellOrder[i] == 1) {
        liveCount += 1;
      } else if (shellOrder[i] == 0) {
        blankCount += 1;
      }
   }
   delay(100);
   lcd.clear();
   if (liveCount == 0 || blankCount == 0) {
    reloadShells();
   } else {
    lcd.print("Live Rounds: " + String(liveCount));
    lcd.setCursor(0,1);
    lcd.print("Empty Rounds: " + String(blankCount));
   }
}
